## main/Kconfig.projbuild
```kconfig
menu "FreeRTOSDemo Configuration"

    config ESP_WIFI_SSID
        string "WiFi SSID for Access Point"
        default "FreeRTOSDemoSSID"
        help
            SSID (network name) for the AP.

    config ESP_WIFI_PASSWORD
        string "WiFi Password for Access Point"
        default "FreeRTOSDemo"
        help
            WiFi password (WPA or WPA2) for the AP.

    config ESP_WIFI_CHANNEL
        int "WiFi Channel"
        range 1 13
        default 1
        help
            WiFi channel (network channel) for the AP.

    config ESP_MAX_STA_CONN
        int "Maximal STA connections"
        default 4
        help
            Max number of the STA connects to AP.

    config SERVER_PORT
        int "TCP socket port"
        range 0 65535
        default 3333
        help
            Local port the TCP server will listen on.
endmenu
```
